## build-hmi/conf/bblayers.conf
```bitbake
POKY_BBLAYERS_CONF_VERSION = "2"

BBPATH = "${TOPDIR}"
BBFILES ?= ""

BBLAYERS ?= " \
  /home/bhargav/yocto-imx6ull/poky/meta \
  /home/bhargav/yocto-imx6ull/poky/meta-poky \
  /home/bhargav/yocto-imx6ull/poky/meta-yocto-bsp \
  /home/bhargav/yocto-imx6ull/meta-openembedded/meta-oe \
  /home/bhargav/yocto-imx6ull/meta-openembedded/meta-python \
  /home/bhargav/yocto-imx6ull/meta-openembedded/meta-networking \
  /home/bhargav/yocto-imx6ull/meta-freescale \
  /home/bhargav/yocto-imx6ull/meta-qt5 \
  /home/bhargav/yocto-imx6ull/meta-swupdate \
  /home/bhargav/yocto-imx6ull/meta-custom-hmi \
"
```

## build-hmi/conf/local.conf
```bitbake
CONF_VERSION = "2"

# Machine & Init Configuration
MACHINE = "imx6ullevk"
KERNEL_DEVICETREE = "okmx6ull-c-emmc.dtb imx6ull-custom-hmi.dtb imx6ull-14x14-evk.dtb"
DISTRO = "poky"
INIT_MANAGER = "systemd"
SERIAL_CONSOLES = "115200;ttymxc0 115200;ttymxc5"
WKS_FILE = "imx-sdcard-ab.wks"

IMX_DEFAULT_BSP = "nxp"
DISTRO_FEATURES:append = " wayland pam opengl"
HOSTTOOLS += "cmake"





IMAGE_BOOT_FILES:append = " \
    okmx6ull-c-emmc.dtb \
    imx6ull-custom-hmi.dtb \
    okmx6ull-c-emmc.dtb;imx6ull-14x14-evk.dtb \
    boot.scr \
    splash.bmp \
    logo.bmp \
"
EXTRA_IMAGEDEPENDS += "u-boot-script"


EXTRA_IMAGE_FEATURES ?= "debug-tweaks"


# Performance tuning for 6-core Intel i5 CPU
BB_NUMBER_THREADS = "6"
PARALLEL_MAKE = "-j 6"

# Qt 5.15 LTS version
PREFERRED_VERSION_qtbase = "5.15%"
PREFERRED_VERSION_qtdeclarative = "5.15%"
PREFERRED_VERSION_qtquickcontrols2 = "5.15%"

# Include Qt 5.15.2, libgpiod, SWUpdate, and Qt5 Cinematic Experience demo
IMAGE_INSTALL:append = " \
    qtbase \
    qtbase-plugins \
    qtdeclarative \
    qtquickcontrols2 \
    libgpiod \
    libgpiod-tools \
    libgpiod-dev \
    avahi-autoipd \
    swupdate \
    cinematicexperience \
"

# Package management & Licensing
LICENSE_FLAGS_ACCEPTED = "commercial"
PACKAGECONFIG:append:pn-qtbase = " linuxfb gsl eglfs tslib"

# Automatically remove intermediate work files to save disk space
INHERIT += "rm_work"

# Accept Freescale EULA
ACCEPT_FSL_EULA = "1"
```

## meta-custom-hmi/recipes-support/swupdate/files/defconfig
```kconfig
#
# Swupdate Configuration for i.MX6ULL Dual-Bank HMI
#
CONFIG_HAVE_DOT_CONFIG=y

#
# Swupdate Settings
#
CONFIG_DEFAULT_CONFIG_FILE="/etc/swupdate.cfg"
CONFIG_SCRIPTS=y
# CONFIG_HW_COMPATIBILITY is not set
CONFIG_SW_VERSIONS_FILE="/etc/sw-versions"

#
# Socket Paths
#
CONFIG_SOCKET_CTRL_PATH=""
CONFIG_SOCKET_PROGRESS_PATH=""
CONFIG_SOCKET_REMOTE_HANDLER_DIRECTORY="/tmp/"
CONFIG_MTD=y
CONFIG_LUA=y
CONFIG_LUAPKG="lua"

#
# Bootloader Interface
#
CONFIG_UBOOT=y
CONFIG_UBOOT_FWENV="/etc/fw_env.config"

#
# Download and SSL Options
#
CONFIG_CURL=y
CONFIG_DOWNLOAD=y
CONFIG_SSL_IMPL_OPENSSL=y

#
# Webserver & Suricatta
#
CONFIG_WEBSERVER=y
CONFIG_MONGOOSE=y
CONFIG_MONGOOSEIPV6=y
CONFIG_SURICATTA=y
CONFIG_SURICATTA_HAWKBIT=y

#
# Compression
#
CONFIG_GUNZIP=y

#
# Parser Features
#
CONFIG_LIBCONFIG=y
CONFIG_PARSERROOT=""

#
# Image Handlers
#
CONFIG_CFI=y
CONFIG_RAW=y
CONFIG_LUASCRIPTHANDLER=y
CONFIG_SHELLSCRIPTHANDLER=y
```
